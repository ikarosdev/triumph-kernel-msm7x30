## drivers/char/ftm_smd/Kconfig
```kconfig
#-------------------------------------------
# Provide a char type driver of smd for FTM to communicate with modem.
# Added by Paul Lo.
menu " FTM communicates with Modem"

config FTM_SMD
	tristate "char driver interface and FTM communicating to/from ARM9"
	default n
	depends on ARCH_MSM || ARCH_QSD
	help
	 Provide a char type driver of smd for FTM to communicate with modem.
endmenu
#-------------------------------------------
```
